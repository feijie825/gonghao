//*****************************************************************************
//
// bl_link.xcl - Linker script for EW-ARM.
//
// Copyright (c) 2007-2008 Luminary Micro, Inc.  All rights reserved.
// 
// Software License Agreement
// 
// Luminary Micro, Inc. (LMI) is supplying this software for use solely and
// exclusively on LMI's microcontroller products.
// 
// The software is owned by LMI and/or its suppliers, and is protected under
// applicable copyright laws.  All rights are reserved.  You may not combine
// this software with "viral" open-source software in order to form a larger
// program.  Any use in violation of the foregoing restrictions may subject
// the user to criminal sanctions under applicable laws, as well as to civil
// liability for the breach of the terms and conditions of this license.
// 
// THIS SOFTWARE IS PROVIDED "AS IS".  NO WARRANTIES, WHETHER EXPRESS, IMPLIED
// OR STATUTORY, INCLUDING, BUT NOT LIMITED TO, IMPLIED WARRANTIES OF
// MERCHANTABILITY AND FITNESS FOR A PARTICULAR PURPOSE APPLY TO THIS SOFTWARE.
// LMI SHALL NOT, IN ANY CIRCUMSTANCES, BE LIABLE FOR SPECIAL, INCIDENTAL, OR
// CONSEQUENTIAL DAMAGES, FOR ANY REASON WHATSOEVER.
// 
// This is part of revision 3416 of the Stellaris Peripheral Driver Library.
//
//*****************************************************************************

//
// Set the CPU type to ARM.
//
-carm

//
// Define the size of flash and SRAM.  This reserves the first 0x44 bytes of
// flash and SRAM for the vector table.
//
-DROMSTART=00000044
-DROMEND=0000ffff
-DRAMSTART=20000044
-DRAMEND=2000ffff

//
// Create a logical to physical mapping of the code and data in SRAM to its
// initial location in flash.
//
-QCODE=ROMCODE
-QINITTAB=ROMINITTAB
-QDATA_C=ROMDATA_C

//
// Place the physical copies of the code and read-only data into flash.  The
// vector table is placed at the beginning of flash.
//
-Z(CODE)INTVEC=0x0-0x43
-Z(CODE)ROMCODE=ROMSTART-ROMEND
-Z(CONST)ROMINITTAB=ROMSTART-ROMEND
-Z(CONST)ROMDATA_C=ROMSTART-ROMEND

//
// Place the logical copies of the code and read-only data into SRAM.
//
-Z(CODE)CODE=RAMSTART-RAMEND
-Z(CONST)INITTAB=RAMSTART-RAMEND
-Z(CONST)DATA_C=RAMSTART-RAMEND

//
// Place the zero-init data into SRAM.
//
-Z(DATA)DATA_Z=RAMSTART-RAMEND
-Z(DATA)DATA_N=RAMSTART-RAMEND
